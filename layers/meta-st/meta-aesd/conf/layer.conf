## layers/meta-st/meta-aesd/conf/layer.conf
```bitbake
# We have a conf and classes directory, add to BBPATH
BBPATH .= ":${LAYERDIR}"

# We have recipes-* directories, add to BBFILES
BBFILES += "${LAYERDIR}/recipes-*/*/*.bb \
            ${LAYERDIR}/recipes-*/*/*.bbappend"

BBFILE_COLLECTIONS += "meta-aesd"
BBFILE_PATTERN_meta-aesd = "^${LAYERDIR}/"
BBFILE_PRIORITY_meta-aesd = "9"

# This should only be incremented on significant changes that may
# cause compatibility issues with other layers
LAYERVERSION_meta-aesd = "9"

# TODO: Add components this layer depends on
LAYERDEPENDS_meta-aesd = " \
	core \
	"

LAYERSERIES_COMPAT_meta-aesd = "thud"
```

## layers/meta-st/meta-aesd/conf/machine/stm32mp1-aesd.conf
```bitbake
#@TYPE: Machine
#@NAME: stm32mp1-aesd
#@DESCRIPTION: Configuration for STM32CubeMX generated project
#@NEEDED_BSPLAYERS: layers/meta-openembedded/meta-oe layers/meta-openembedded/meta-python layers/meta-st/meta-st-stm32mp-addons

include conf/machine/include/st-machine-common-stm32mp.inc
include conf/machine/include/stm32mp1-mx-config.inc
include conf/machine/include/stm32mp1-mx-extlinux-config.inc
include conf/machine/include/stm32mp1-mx-common.inc

# Define specific common machine name
MACHINEOVERRIDES .= ":stm32mpaesd"

# =========================================================================
# CubeMX extra config
# =========================================================================
# Set specific path by components for DT file location
# TODO: Declare STM32MP_AESD variable in layer.conf file
CUBEMX_DTB_PATH_TFA     = "${STM32MP_AESD}/mx/${CUBEMX_PROJECT}/tf-a"
CUBEMX_DTB_PATH_UBOOT   = "${STM32MP_AESD}/mx/${CUBEMX_PROJECT}/u-boot"
CUBEMX_DTB_PATH_LINUX   = "${STM32MP_AESD}/mx/${CUBEMX_PROJECT}/kernel"
CUBEMX_DTB_PATH_OPTEEOS = "${STM32MP_AESD}/mx/${CUBEMX_PROJECT}/optee-os"

# =========================================================================
# User customizing sections
# =========================================================================

# Boot Scheme
# =========================================================================
# DISCO / EVAL : basic, trusted or optee
# =========================================================================
# TODO: Select boot scheme - usually choose trusted
#BOOTSCHEME_LABELS += "basic"
BOOTSCHEME_LABELS += "trusted"
#BOOTSCHEME_LABELS += "optee"

# Boot Device Choice
# =========================================================================
# DISCO : sdcard
# EVAL  : sdcard, emmc, nand-4-256, nor-sdcard, nor-emmc or nor-nand-4-256
# =========================================================================
# Define the boot device supported
# TODO: Select boot device - depends on your platform
# Use sdcard if using sdcard with STM32MP157-DK1 Board
BOOTDEVICE_LABELS += "sdcard"

# WARNING: configs below are only available with EVAL board
#BOOTDEVICE_LABELS += "emmc"
#BOOTDEVICE_LABELS += "nand-4-256"
#BOOTDEVICE_LABELS += "nor-emmc"
#BOOTDEVICE_LABELS += "nor-nand-4-256"
#BOOTDEVICE_LABELS += "nor-sdcard"

# Board Type Choice
# =========================================================================
# DISCO : stm32mp157a-dk1 or stm32mp157c-dk2
# EVAL  : stm32mp157c-ev1
# =========================================================================
# Define the board reference devicetree name
# WARNING: only one setting allowed
CUBEMX_BOARD_REFERENCE = "stm32mp157a-dk1"
#CUBEMX_BOARD_REFERENCE = "stm32mp157c-dk2"
#CUBEMX_BOARD_REFERENCE = "stm32mp157c-ev1"

# CubeMX Project Config
# =========================================================================
# Assign CubeMX Board devicetree and project path name
# This should match with your device tree file names -> *.dts files
CUBEMX_DTB = "stm32mp157a-aesd-mx"
# This should point to location where device tree files are saved
CUBEMX_PROJECT = "STM32MP157A-DK1/aesd/DeviceTree/aesd"
```
